## arch/arm/mach-msm/Kconfig.rej
```kconfig
--- arch/arm/mach-msm/Kconfig
+++ arch/arm/mach-msm/Kconfig
@@ -1572,6 +1572,12 @@
 
 endif # CPU_FREQ_MSM
 
+config USERSPACE_VOLTAGE_CONTROL
+	bool "Enable Userspace CPU Voltage Control"
+	default y
+	help
+	  Userspace Voltage Control
+
 config MSM_CPU_AVS
 	bool "Enable software controlled Adaptive Voltage Scaling (AVS)"
 	depends on (ARCH_MSM_SCORPION && QSD_SVS)
```
